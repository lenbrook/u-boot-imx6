## board/nad/mx6/Kconfig
```kconfig
if TARGET_NAD_NMB

config SYS_BOARD
	default "mx6"

config SYS_VENDOR
	default "nad"

config SYS_CONFIG_NAME
	default "nad_nmb"

config NAD_DRAM_HALF_GIG
	bool "NMB has 512MB RAM"
	default "n"

config NAD_BOOT_GPIO_VM300
	bool "Boot GPIO VM300"
	default "n"

config NAD_BOOT_GPIO_C658
	bool "Boot GPIO C658"
	default "n"

config MFG
	bool "Build u-boot for use with mfg flasher."
	default "n"

endif
```

## board/nad/mx6sl/Kconfig
```kconfig
if TARGET_NAD_MX6SL

config SYS_BOARD
	default "mx6sl"

config SYS_VENDOR
	default "nad"

config SYS_CONFIG_NAME
	default "nad_mx6sl"

config NAD_C390V2
	bool "C390v2"
	default "n"

config MFG
	bool "Build u-boot for use with mfg flasher."
	default "n"

endif
```

## configs/nad_c390v2_defconfig
```kconfig
CONFIG_ARM=y
CONFIG_ARCH_MX6=y
CONFIG_SYS_TEXT_BASE=0x87800000
CONFIG_TARGET_NAD_MX6SL=y
CONFIG_SYS_EXTRA_OPTIONS="IMX_CONFIG=board/nad/mx6sl/800mhz_2x64mx16.cfg,MX6SL"
CONFIG_SYS_CONSOLE_OVERWRITE_ROUTINE=y
CONFIG_BOOTDELAY=0
CONFIG_ENV_IS_IN_MMC=y
CONFIG_BOARD_EARLY_INIT_F=y
CONFIG_CMD_BOOTZ=y
CONFIG_CMD_GPIO=y
CONFIG_CMD_I2C=y
CONFIG_CMD_MMC=y
CONFIG_CMD_USB=y
CONFIG_CMD_DHCP=y
CONFIG_CMD_MII=y
CONFIG_CMD_PING=y
CONFIG_CMD_CACHE=y
CONFIG_CMD_EXT2=y
CONFIG_CMD_FAT=y
CONFIG_PHYLIB=y
CONFIG_PHY_SMSC=y
CONFIG_USB=y
CONFIG_USB_EHCI=y
CONFIG_OF_LIBFDT=y
# CONFIG_VIDEO=y
# CONFIG_VIDEO_SW_CURSOR is not set
CONFIG_BAUDRATE_PIC=115200
CONFIG_NAD_C390V2=y
```

## configs/nad_c658_mfg_defconfig
```kconfig
CONFIG_ARM=y
CONFIG_ARCH_MX6=y
CONFIG_SYS_TEXT_BASE=0x17800000
CONFIG_TARGET_NAD_NMB=y
CONFIG_SYS_EXTRA_OPTIONS="IMX_CONFIG=board/nad/mx6/nad_vm301.cfg,MX6DL"
CONFIG_SYS_CONSOLE_OVERWRITE_ROUTINE=y
CONFIG_BOOTDELAY=0
CONFIG_BOARD_EARLY_INIT_F=y
CONFIG_CMD_BOOTZ=y
CONFIG_CMD_GPIO=y
CONFIG_CMD_I2C=y
CONFIG_CMD_MMC=y
CONFIG_CMD_USB=y
CONFIG_CMD_DHCP=y
CONFIG_CMD_MII=y
CONFIG_CMD_PING=y
CONFIG_CMD_CACHE=y
CONFIG_CMD_EXT2=y
CONFIG_CMD_FAT=y
CONFIG_PHYLIB=y
CONFIG_PHY_SMSC=y
CONFIG_PHY_GIGE=y
CONFIG_USB=y
CONFIG_USB_EHCI=y
CONFIG_OF_LIBFDT=y
CONFIG_NAD_BOOT_GPIO_C658=y
# CONFIG_VIDEO=y
# CONFIG_VIDEO_SW_CURSOR is not set
CONFIG_BAUDRATE_PIC=115200
CONFIG_NAD_DRAM_HALF_GIG=y
CONFIG_MFG=y
```
